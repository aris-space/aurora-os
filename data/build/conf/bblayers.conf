## data/build/conf/bblayers.conf
```bitbake
# POKY_BBLAYERS_CONF_VERSION is increased each time build/conf/bblayers.conf
# changes incompatibly
POKY_BBLAYERS_CONF_VERSION = "2"

BBPATH = "${TOPDIR}"
BBFILES ?= ""

BBLAYERS ?= " \
  /data/poky/meta \
  /data/poky/meta-poky \
  /data/poky/meta-yocto-bsp \
  /data/meta-openembedded/meta-oe \
  /data/meta-openembedded/meta-python \
  /data/meta-st-stm32mp \
  "
```

## data/meta-aurora/conf/layer.conf
```bitbake
# We have a conf and classes directory, add to BBPATH
BBPATH .= ":${LAYERDIR}"

# We have recipes-* directories, add to BBFILES
BBFILES += "${LAYERDIR}/recipes-*/*/*.bb \
            ${LAYERDIR}/recipes-*/*/*.bbappend"

BBFILE_COLLECTIONS += "meta-aurora"
BBFILE_PATTERN_meta-aurora = "^${LAYERDIR}/"
BBFILE_PRIORITY_meta-aurora = "6"

LAYERDEPENDS_meta-aurora = "core"
LAYERSERIES_COMPAT_meta-aurora = "kirkstone"
```
